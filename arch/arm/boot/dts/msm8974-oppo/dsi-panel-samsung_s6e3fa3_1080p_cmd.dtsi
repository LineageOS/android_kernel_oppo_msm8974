/* Copyright (c) 2014, The Linux Foundation. All rights reserved.
 *
 * This program is free software; you can redistribute it and/or modify
 * it under the terms of the GNU General Public License version 2 and
 * only version 2 as published by the Free Software Foundation.
 *
 * This program is distributed in the hope that it will be useful,
 * but WITHOUT ANY WARRANTY; without even the implied warranty of
 * MERCHANTABILITY or FITNESS FOR A PARTICULAR PURPOSE.  See the
 * GNU General Public License for more details.
 */

&mdss_mdp {
	dsi_samsung_s6e3fa3_1080p_cmd: qcom,mdss_dsi_samsung_s6e3fa3_1080p_cmd {
		qcom,cont-splash-enabled;
		qcom,mdss-dsi-panel-name = "Samsung S6E3FA3 1080p cmd mode dsi panel";
		qcom,mdss-dsi-panel-controller = <&mdss_dsi0>;
		qcom,mdss-dsi-panel-type = "dsi_cmd_mode";
		qcom,mdss-dsi-panel-destination = "display_1";
		qcom,mdss-dsi-panel-width = <1080>;
		qcom,mdss-dsi-panel-height = <1920>;
		qcom,mdss-dsi-h-front-porch = <120>;
		qcom,mdss-dsi-h-back-porch = <70>;
		qcom,mdss-dsi-h-pulse-width = <19>;
		qcom,mdss-dsi-v-back-porch = <4>;
		qcom,mdss-dsi-v-front-porch = <18>;
		qcom,mdss-dsi-v-pulse-width = <2>;
		qcom,mdss-dsi-bpp = <24>;
		qcom,mdss-dsi-on-command = [
			05 01 00 00 00 00 02 29 00
			05 01 00 00 10 00 02 11 00
			15 01 00 00 00 00 02 35 00
			15 01 00 00 00 00 02 53 20
			15 01 00 00 00 00 02 55 01
			29 01 00 00 00 00 03 FC 5A 5A
			15 01 00 00 00 00 02 B0 1E
			15 01 00 00 00 00 02 FD 9E
			29 01 00 00 00 00 03 FC A5 A5];
		qcom,mdss-dsi-off-command = [
			05 01 00 00 10 00 02 28 00
			05 01 00 00 A0 00 02 10 00];
		cm,mdss-livedisplay-cabc-cmd = [
			15 01 00 00 10 00 02 55 00];
		cm,mdss-livedisplay-cabc-ui-value = <0x01>;
		cm,mdss-livedisplay-cabc-image-value = <0x02>;
		cm,mdss-livedisplay-cabc-video-value = <0x03>;
		cm,mdss-livedisplay-sre-weak-value = <0x50>;
		cm,mdss-livedisplay-sre-medium-value = <0x60>;
		cm,mdss-livedisplay-sre-strong-value = <0x70>;
		cm,mdss-livedisplay-aco-value = <0x80>;
		cm,mdss-livedisplay-post-cmd = [
			15 01 00 00 14 00 02 29 00];
		qcom,mdss-dsi-off-command-state = "dsi_hs_mode";
		qcom,mdss-dsi-h-sync-pulse = <1>;
		qcom,mdss-dsi-bllp-eof-power-mode;
		qcom,mdss-dsi-bllp-power-mode;
		qcom,mdss-dsi-lane-0-state;
		qcom,mdss-dsi-lane-1-state;
		qcom,mdss-dsi-lane-2-state;
		qcom,mdss-dsi-lane-3-state;
		qcom,mdss-dsi-panel-timings = [f0 3c 26 00 6a 6a 30 3c 32 03 04 00];
		qcom,mdss-dsi-te-check-enable;
		qcom,mdss-dsi-te-using-te-pin;
		qcom,mdss-dsi-t-clk-post = <0x20>;
		qcom,mdss-dsi-t-clk-pre = <0x3e>;
		qcom,mdss-dsi-bl-min-level = <1>;
		qcom,mdss-dsi-bl-pmic-control-type = "bl_ctrl_dcs";
		qcom,mdss-dsi-reset-sequence = <1 5>, <0 1>, <1 10>;
		qcom,mdss-pan-physical-width-dimension = <62>;
		qcom,mdss-pan-physical-height-dimension = <111>;
		qcom,ulps-enabled;
	};
};
