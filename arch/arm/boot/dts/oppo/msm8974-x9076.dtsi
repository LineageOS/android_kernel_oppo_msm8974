/* Copyright (c) 2012-2014, The Linux Foundation. All rights reserved.
 *
 * This program is free software; you can redistribute it and/or modify
 * it under the terms of the GNU General Public License version 2 and
 * only version 2 as published by the Free Software Foundation.
 *
 * This program is distributed in the hope that it will be useful,
 * but WITHOUT ANY WARRANTY; without even the implied warranty of
 * MERCHANTABILITY or FITNESS FOR A PARTICULAR PURPOSE.  See the
 * GNU General Public License for more details.
 */

/include/ "msm8974-oppo.dtsi"
/include/ "msm8974-x90x6.dtsi"
/include/ "msm8974-leds-x9076.dtsi"
/include/ "msm8974-mdss-x9076.dtsi"

&soc {
	qcom,mdss_dsi@fd922e00 {
		qcom,dsi-pref-find7s-jdi-pan = <&dsi_jdi_1440_vid2>;
	};
};
