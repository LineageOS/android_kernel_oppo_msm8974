/* Copyright (c) 2012-2014, The Linux Foundation. All rights reserved.
 *
 * This program is free software; you can redistribute it and/or modify
 * it under the terms of the GNU General Public License version 2 and
 * only version 2 as published by the Free Software Foundation.
 *
 * This program is distributed in the hope that it will be useful,
 * but WITHOUT ANY WARRANTY; without even the implied warranty of
 * MERCHANTABILITY or FITNESS FOR A PARTICULAR PURPOSE.  See the
 * GNU General Public License for more details.
 */

/include/ "msm8974-oppo.dtsi"
/include/ "msm8974-x90x6.dtsi"

&soc {
	qcom,mdss_dsi@fd922800 {
		qcom,dsi-pref-prim-pan = <&dsi_jdi_1080_cmd>;
	};

	i2c@f9924000 {
		sn3193_issi_rgb@68 {
			compatible = "sn3193,issi-rgb";
			reg = <0x68>;
			sn3193,sdb-gpio = <&msmgpio 45 0x00>;
		};
	};
};
